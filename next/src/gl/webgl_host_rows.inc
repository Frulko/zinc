// generated by tools/gen-zinc-gl: the Rt::HostGl* rows (do not edit)
    case Rt::HostGlGetError: { r->i = c->lost ? c->lostError() : gl.getError(); break; }
    case Rt::HostGlEnable: { gl.enable(U(a[1])); break; }
    case Rt::HostGlDisable: { gl.disable(U(a[1])); break; }
    case Rt::HostGlIsEnabled: { r->i = gl.isEnabled(U(a[1])); break; }
    case Rt::HostGlViewport: { gl.viewport(I(a[1]), I(a[2]), I(a[3]), I(a[4])); break; }
    case Rt::HostGlScissor: { gl.scissor(I(a[1]), I(a[2]), I(a[3]), I(a[4])); break; }
    case Rt::HostGlClearColor: { gl.clearColor(F(a[1]), F(a[2]), F(a[3]), F(a[4])); break; }
    case Rt::HostGlClear: { gl.clear(U(a[1])); break; }
    case Rt::HostGlClearDepth: { gl.clearDepth(F(a[1])); break; }
    case Rt::HostGlClearStencil: { gl.clearStencil(I(a[1])); break; }
    case Rt::HostGlColorMask: { gl.colorMask((a[1].i != 0), (a[2].i != 0), (a[3].i != 0), (a[4].i != 0)); break; }
    case Rt::HostGlPixelStorei: { gl.pixelStorei(U(a[1]), I(a[2])); break; }
    case Rt::HostGlBlendColor: { gl.blendColor(F(a[1]), F(a[2]), F(a[3]), F(a[4])); break; }
    case Rt::HostGlBlendEquation: { gl.blendEquation(U(a[1])); break; }
    case Rt::HostGlBlendEquationSeparate: { gl.blendEquationSeparate(U(a[1]), U(a[2])); break; }
    case Rt::HostGlBlendFunc: { gl.blendFunc(U(a[1]), U(a[2])); break; }
    case Rt::HostGlBlendFuncSeparate: { gl.blendFuncSeparate(U(a[1]), U(a[2]), U(a[3]), U(a[4])); break; }
    case Rt::HostGlCullFace: { gl.cullFace(U(a[1])); break; }
    case Rt::HostGlFrontFace: { gl.frontFace(U(a[1])); break; }
    case Rt::HostGlDepthFunc: { gl.depthFunc(U(a[1])); break; }
    case Rt::HostGlDepthMask: { gl.depthMask((a[1].i != 0)); break; }
    case Rt::HostGlDepthRange: { gl.depthRange(F(a[1]), F(a[2])); break; }
    case Rt::HostGlHint: { gl.hint(U(a[1]), U(a[2])); break; }
    case Rt::HostGlLineWidth: { gl.lineWidth(F(a[1])); break; }
    case Rt::HostGlPolygonOffset: { gl.polygonOffset(F(a[1]), F(a[2])); break; }
    case Rt::HostGlSampleCoverage: { gl.sampleCoverage(F(a[1]), (a[2].i != 0)); break; }
    case Rt::HostGlStencilFunc: { gl.stencilFunc(U(a[1]), I(a[2]), U(a[3])); break; }
    case Rt::HostGlStencilFuncSeparate: { gl.stencilFuncSeparate(U(a[1]), U(a[2]), I(a[3]), U(a[4])); break; }
    case Rt::HostGlStencilMask: { gl.stencilMask(U(a[1])); break; }
    case Rt::HostGlStencilMaskSeparate: { gl.stencilMaskSeparate(U(a[1]), U(a[2])); break; }
    case Rt::HostGlStencilOp: { gl.stencilOp(U(a[1]), U(a[2]), U(a[3])); break; }
    case Rt::HostGlStencilOpSeparate: { gl.stencilOpSeparate(U(a[1]), U(a[2]), U(a[3]), U(a[4])); break; }
    case Rt::HostGlFlush: { gl.flush(); break; }
    case Rt::HostGlFinish: { gl.finish(); break; }
    case Rt::HostGlGetParameter: { c->param = gl.getParameter(U(a[1])); break; }
    case Rt::HostGlGetContextAttributes: { r->i = c->attributes; break; }
    case Rt::HostGlIsContextLost: { r->i = c->lost; break; }
    case Rt::HostGlGetExtension: { r->i = c->enableExtension(S(a[1])); break; }
    case Rt::HostGlGetSupportedExtensions: { retStr(r, c->supportedExtensions()); break; }
    case Rt::HostGlGetShaderPrecisionFormat: { { int o[3] = {0, 0, 0}; gl.getShaderPrecisionFormat(U(a[1]), U(a[2]), o); c->param = WebGL1::Param{'a', {double(o[0]), double(o[1]), double(o[2])}, {}, 0, 0, true}; } break; }
    case Rt::HostGlCreateBuffer: { r->i = gl.createBuffer(); break; }
    case Rt::HostGlDeleteBuffer: { gl.deleteBuffer(U(a[1])); break; }
    case Rt::HostGlIsBuffer: { r->i = gl.isBuffer(U(a[1])); break; }
    case Rt::HostGlBindBuffer: { gl.bindBuffer(U(a[1]), U(a[2])); break; }
    case Rt::HostGlBufferData: { const Bytes v2 = bytesIn(a[2], a[3]); if (v2.null) gl.raise(0x0501); else gl.bufferData(U(a[1]), v2.n, v2.p, U(a[4])); break; }
    case Rt::HostGlBufferDataSize: { gl.bufferData(U(a[1]), I(a[2]), nullptr, U(a[3])); break; }
    case Rt::HostGlBufferSubData: { const Bytes v3 = bytesIn(a[3], a[4]); if (!v3.null) gl.bufferSubData(U(a[1]), I(a[2]), v3.n, v3.p); break; }
    case Rt::HostGlGetBufferParameter: { c->param = gl.getBufferParameter(U(a[1]), U(a[2])); break; }
    case Rt::HostGlCopyBufferSubData: { gl.copyBufferSubData(U(a[1]), U(a[2]), I(a[3]), I(a[4]), I(a[5])); break; }
    case Rt::HostGlGetBufferSubData: { Bytes v3 = bytesOut(a[3], a[4]); gl.getBufferSubData(U(a[1]), I(a[2]), v3.p, v3.n); bytesBack(v3, a[3]); break; }
    case Rt::HostGlCreateShader: { r->i = gl.createShader(U(a[1])); break; }
    case Rt::HostGlDeleteShader: { gl.deleteShader(U(a[1])); break; }
    case Rt::HostGlIsShader: { r->i = gl.isShader(U(a[1])); break; }
    case Rt::HostGlShaderSource: { gl.shaderSource(U(a[1]), S(a[2])); break; }
    case Rt::HostGlCompileShader: { gl.compileShader(U(a[1])); break; }
    case Rt::HostGlGetShaderSource: { retStr(r, gl.shaderSourceOf(U(a[1]))); break; }
    case Rt::HostGlGetShaderParameter: { if (!gl.shaderQueryOk(U(a[1]), U(a[2]))) c->param = WebGL1::Param{}; else if (U(a[2]) == 0x8B4F) c->param = WebGL1::Param{'i', {double(gl.shaderTypeOf(U(a[1])))}, {}, 0, 0, true}; else c->param = WebGL1::Param{'b', {double(U(a[2]) == 0x8B81 ? gl.shaderCompiled(U(a[1])) : gl.isDeletedShader(U(a[1])))}, {}, 0, 0, true}; break; }
    case Rt::HostGlGetShaderInfoLog: { retStr(r, gl.shaderInfoLog(U(a[1]))); break; }
    case Rt::HostGlCreateProgram: { r->i = gl.createProgram(); break; }
    case Rt::HostGlDeleteProgram: { gl.deleteProgram(U(a[1])); break; }
    case Rt::HostGlIsProgram: { r->i = gl.isProgram(U(a[1])); break; }
    case Rt::HostGlAttachShader: { gl.attachShader(U(a[1]), U(a[2])); break; }
    case Rt::HostGlDetachShader: { gl.detachShader(U(a[1]), U(a[2])); break; }
    case Rt::HostGlGetAttachedShaders: { { std::string s; for (Id id : gl.attachedShaders(U(a[1]))) s += std::to_string(id) + ' '; retStr(r, s); } break; }
    case Rt::HostGlBindAttribLocation: { gl.bindAttribLocation(U(a[1]), U(a[2]), S(a[3])); break; }
    case Rt::HostGlLinkProgram: { gl.linkProgram(U(a[1])); break; }
    case Rt::HostGlValidateProgram: { gl.validateProgram(U(a[1])); break; }
    case Rt::HostGlUseProgram: { gl.useProgram(U(a[1])); break; }
    case Rt::HostGlGetProgramParameter: { { bool ok = false; const int v = gl.programParameter(U(a[1]), U(a[2]), ok); c->param = !ok ? WebGL1::Param{} : WebGL1::Param{U(a[2]) == 0x8B80 || U(a[2]) == 0x8B82 || U(a[2]) == 0x8B83 ? 'b' : 'i', {double(v)}, {}, 0, 0, true}; } break; }
    case Rt::HostGlGetProgramInfoLog: { retStr(r, gl.programInfoLog(U(a[1]))); break; }
    case Rt::HostGlGetActiveUniform: { c->active = gl.getActiveUniform(U(a[1]), U(a[2])); break; }
    case Rt::HostGlGetActiveAttrib: { c->active = gl.getActiveAttrib(U(a[1]), U(a[2])); break; }
    case Rt::HostGlGetAttribLocation: { r->i = gl.getAttribLocation(U(a[1]), S(a[2])); break; }
    case Rt::HostGlGetUniformLocation: { r->i = c->location(gl.getUniformLocation(U(a[1]), S(a[2]))); break; }
    case Rt::HostGlGetUniform: { c->param = gl.getUniform(U(a[1]), loc(*c, a[2].i)); break; }
    case Rt::HostGlGetFragDataLocation: { r->i = gl.getFragDataLocation(U(a[1]), S(a[2])); break; }
    case Rt::HostGlUniform1f: { gl.uniform1f(loc(*c, a[1].i), F(a[2])); break; }
    case Rt::HostGlUniform1i: { gl.uniform1i(loc(*c, a[1].i), I(a[2])); break; }
    case Rt::HostGlUniform1ui: { { const std::uint32_t v[4] = {U(a[2])}; gl.uniformNui(loc(*c, a[1].i), 1, v, 1); } break; }
    case Rt::HostGlUniform1fv: { const auto& v2 = floats(a[2]); gl.uniformNfv(loc(*c, a[1].i), 1, v2.data(), v2.size()); break; }
    case Rt::HostGlUniform1iv: { const auto& v2 = ints(a[2]); gl.uniformNiv(loc(*c, a[1].i), 1, v2.data(), v2.size()); break; }
    case Rt::HostGlUniform1uiv: { const auto& v2 = uints(a[2]); gl.uniformNui(loc(*c, a[1].i), 1, v2.data(), v2.size()); break; }
    case Rt::HostGlUniform2f: { gl.uniform2f(loc(*c, a[1].i), F(a[2]), F(a[3])); break; }
    case Rt::HostGlUniform2i: { gl.uniform2i(loc(*c, a[1].i), I(a[2]), I(a[3])); break; }
    case Rt::HostGlUniform2ui: { { const std::uint32_t v[4] = {U(a[2]), U(a[3])}; gl.uniformNui(loc(*c, a[1].i), 2, v, 2); } break; }
    case Rt::HostGlUniform2fv: { const auto& v2 = floats(a[2]); gl.uniformNfv(loc(*c, a[1].i), 2, v2.data(), v2.size()); break; }
    case Rt::HostGlUniform2iv: { const auto& v2 = ints(a[2]); gl.uniformNiv(loc(*c, a[1].i), 2, v2.data(), v2.size()); break; }
    case Rt::HostGlUniform2uiv: { const auto& v2 = uints(a[2]); gl.uniformNui(loc(*c, a[1].i), 2, v2.data(), v2.size()); break; }
    case Rt::HostGlUniform3f: { gl.uniform3f(loc(*c, a[1].i), F(a[2]), F(a[3]), F(a[4])); break; }
    case Rt::HostGlUniform3i: { gl.uniform3i(loc(*c, a[1].i), I(a[2]), I(a[3]), I(a[4])); break; }
    case Rt::HostGlUniform3ui: { { const std::uint32_t v[4] = {U(a[2]), U(a[3]), U(a[4])}; gl.uniformNui(loc(*c, a[1].i), 3, v, 3); } break; }
    case Rt::HostGlUniform3fv: { const auto& v2 = floats(a[2]); gl.uniformNfv(loc(*c, a[1].i), 3, v2.data(), v2.size()); break; }
    case Rt::HostGlUniform3iv: { const auto& v2 = ints(a[2]); gl.uniformNiv(loc(*c, a[1].i), 3, v2.data(), v2.size()); break; }
    case Rt::HostGlUniform3uiv: { const auto& v2 = uints(a[2]); gl.uniformNui(loc(*c, a[1].i), 3, v2.data(), v2.size()); break; }
    case Rt::HostGlUniform4f: { gl.uniform4f(loc(*c, a[1].i), F(a[2]), F(a[3]), F(a[4]), F(a[5])); break; }
    case Rt::HostGlUniform4i: { gl.uniform4i(loc(*c, a[1].i), I(a[2]), I(a[3]), I(a[4]), I(a[5])); break; }
    case Rt::HostGlUniform4ui: { { const std::uint32_t v[4] = {U(a[2]), U(a[3]), U(a[4]), U(a[5])}; gl.uniformNui(loc(*c, a[1].i), 4, v, 4); } break; }
    case Rt::HostGlUniform4fv: { const auto& v2 = floats(a[2]); gl.uniformNfv(loc(*c, a[1].i), 4, v2.data(), v2.size()); break; }
    case Rt::HostGlUniform4iv: { const auto& v2 = ints(a[2]); gl.uniformNiv(loc(*c, a[1].i), 4, v2.data(), v2.size()); break; }
    case Rt::HostGlUniform4uiv: { const auto& v2 = uints(a[2]); gl.uniformNui(loc(*c, a[1].i), 4, v2.data(), v2.size()); break; }
    case Rt::HostGlUniformMatrix2fv: { const auto& v3 = floats(a[3]); gl.uniformMatrixNfv(loc(*c, a[1].i), 2, (a[2].i != 0), v3.data(), v3.size()); break; }
    case Rt::HostGlUniformMatrix3fv: { const auto& v3 = floats(a[3]); gl.uniformMatrixNfv(loc(*c, a[1].i), 3, (a[2].i != 0), v3.data(), v3.size()); break; }
    case Rt::HostGlUniformMatrix4fv: { const auto& v3 = floats(a[3]); gl.uniformMatrix4fv(loc(*c, a[1].i), (a[2].i != 0), v3.data(), v3.size()); break; }
    case Rt::HostGlUniformMatrix2x3fv: { const auto& v3 = floats(a[3]); gl.uniformMatrixRC(loc(*c, a[1].i), 2, 3, (a[2].i != 0), v3.data(), v3.size()); break; }
    case Rt::HostGlUniformMatrix2x4fv: { const auto& v3 = floats(a[3]); gl.uniformMatrixRC(loc(*c, a[1].i), 2, 4, (a[2].i != 0), v3.data(), v3.size()); break; }
    case Rt::HostGlUniformMatrix3x2fv: { const auto& v3 = floats(a[3]); gl.uniformMatrixRC(loc(*c, a[1].i), 3, 2, (a[2].i != 0), v3.data(), v3.size()); break; }
    case Rt::HostGlUniformMatrix3x4fv: { const auto& v3 = floats(a[3]); gl.uniformMatrixRC(loc(*c, a[1].i), 3, 4, (a[2].i != 0), v3.data(), v3.size()); break; }
    case Rt::HostGlUniformMatrix4x2fv: { const auto& v3 = floats(a[3]); gl.uniformMatrixRC(loc(*c, a[1].i), 4, 2, (a[2].i != 0), v3.data(), v3.size()); break; }
    case Rt::HostGlUniformMatrix4x3fv: { const auto& v3 = floats(a[3]); gl.uniformMatrixRC(loc(*c, a[1].i), 4, 3, (a[2].i != 0), v3.data(), v3.size()); break; }
    case Rt::HostGlGetUniformBlockIndex: { r->i = gl.getUniformBlockIndex(U(a[1]), S(a[2])); break; }
    case Rt::HostGlUniformBlockBinding: { gl.uniformBlockBinding(U(a[1]), U(a[2]), U(a[3])); break; }
    case Rt::HostGlGetActiveUniformBlockParameter: { c->param = gl.getActiveUniformBlockParameter(U(a[1]), U(a[2]), U(a[3])); break; }
    case Rt::HostGlGetActiveUniformBlockName: { { bool ok = false; std::string s = gl.getActiveUniformBlockName(U(a[1]), U(a[2]), ok); retStr(r, ok ? s : std::string("\x01")); } break; }
    case Rt::HostGlGetUniformIndices: { const auto v2 = lines(S(a[2])); { std::string s; for (std::uint32_t i : gl.getUniformIndices(U(a[1]), v2)) s += std::to_string(i) + ' '; retStr(r, s); } break; }
    case Rt::HostGlGetActiveUniforms: { const auto& v2 = uints(a[2]); { bool ok = false; c->param = gl.getActiveUniforms(U(a[1]), std::vector<std::uint32_t>(v2.data(), v2.data() + v2.size()), U(a[3]), ok); if (!ok) c->param = WebGL1::Param{}; } break; }
    case Rt::HostGlEnableVertexAttribArray: { gl.enableVertexAttribArray(U(a[1])); break; }
    case Rt::HostGlDisableVertexAttribArray: { gl.disableVertexAttribArray(U(a[1])); break; }
    case Rt::HostGlVertexAttribPointer: { gl.vertexAttribPointer(U(a[1]), I(a[2]), U(a[3]), (a[4].i != 0), I(a[5]), I(a[6])); break; }
    case Rt::HostGlVertexAttribIPointer: { gl.vertexAttribIPointer(U(a[1]), I(a[2]), U(a[3]), I(a[4]), I(a[5])); break; }
    case Rt::HostGlVertexAttrib1f: { { const float v[4] = {F(a[2])}; gl.vertexAttribNf(U(a[1]), 1, v); } break; }
    case Rt::HostGlVertexAttrib1fv: { const auto& v2 = floats(a[2]); if (v2.size() < 1) gl.raise(0x0501); else gl.vertexAttribNf(U(a[1]), 1, v2.data()); break; }
    case Rt::HostGlVertexAttrib2f: { { const float v[4] = {F(a[2]), F(a[3])}; gl.vertexAttribNf(U(a[1]), 2, v); } break; }
    case Rt::HostGlVertexAttrib2fv: { const auto& v2 = floats(a[2]); if (v2.size() < 2) gl.raise(0x0501); else gl.vertexAttribNf(U(a[1]), 2, v2.data()); break; }
    case Rt::HostGlVertexAttrib3f: { { const float v[4] = {F(a[2]), F(a[3]), F(a[4])}; gl.vertexAttribNf(U(a[1]), 3, v); } break; }
    case Rt::HostGlVertexAttrib3fv: { const auto& v2 = floats(a[2]); if (v2.size() < 3) gl.raise(0x0501); else gl.vertexAttribNf(U(a[1]), 3, v2.data()); break; }
    case Rt::HostGlVertexAttrib4f: { { const float v[4] = {F(a[2]), F(a[3]), F(a[4]), F(a[5])}; gl.vertexAttribNf(U(a[1]), 4, v); } break; }
    case Rt::HostGlVertexAttrib4fv: { const auto& v2 = floats(a[2]); if (v2.size() < 4) gl.raise(0x0501); else gl.vertexAttribNf(U(a[1]), 4, v2.data()); break; }
    case Rt::HostGlVertexAttribI4i: { { const int v[4] = {I(a[2]), I(a[3]), I(a[4]), I(a[5])}; gl.vertexAttribINi(U(a[1]), v); } break; }
    case Rt::HostGlVertexAttribI4ui: { { const std::uint32_t v[4] = {U(a[2]), U(a[3]), U(a[4]), U(a[5])}; gl.vertexAttribINui(U(a[1]), v); } break; }
    case Rt::HostGlVertexAttribI4iv: { const auto& v2 = ints(a[2]); if (v2.size() < 4) gl.raise(0x0501); else gl.vertexAttribINi(U(a[1]), v2.data()); break; }
    case Rt::HostGlVertexAttribI4uiv: { const auto& v2 = uints(a[2]); if (v2.size() < 4) gl.raise(0x0501); else gl.vertexAttribINui(U(a[1]), v2.data()); break; }
    case Rt::HostGlGetVertexAttrib: { c->param = gl.getVertexAttrib(U(a[1]), U(a[2])); break; }
    case Rt::HostGlGetVertexAttribOffset: { if (U(a[2]) != 0x8645) gl.raise(0x0500); else if (U(a[1]) >= 16) gl.raise(0x0501); else r->i = gl.attribOffset(U(a[1])); break; }
    case Rt::HostGlVertexAttribDivisor: { gl.vertexAttribDivisor(U(a[1]), U(a[2])); break; }
    case Rt::HostGlDrawArrays: { gl.drawArrays(U(a[1]), I(a[2]), I(a[3])); break; }
    case Rt::HostGlDrawElements: { gl.drawElements(U(a[1]), I(a[2]), U(a[3]), I(a[4])); break; }
    case Rt::HostGlDrawArraysInstanced: { gl.drawArraysInstanced(U(a[1]), I(a[2]), I(a[3]), I(a[4])); break; }
    case Rt::HostGlDrawElementsInstanced: { gl.drawElementsInstanced(U(a[1]), I(a[2]), U(a[3]), I(a[4]), I(a[5])); break; }
    case Rt::HostGlDrawRangeElements: { gl.drawRangeElements(U(a[1]), U(a[2]), U(a[3]), I(a[4]), U(a[5]), I(a[6])); break; }
    case Rt::HostGlDrawBuffers: { const auto& v1 = uints(a[1]); gl.drawBuffers(v1.data(), static_cast<int>(v1.size())); break; }
    case Rt::HostGlReadBuffer: { gl.readBuffer(U(a[1])); break; }
    case Rt::HostGlCreateVertexArray: { r->i = gl.createVertexArray(); break; }
    case Rt::HostGlDeleteVertexArray: { gl.deleteVertexArray(U(a[1])); break; }
    case Rt::HostGlIsVertexArray: { r->i = gl.isVertexArray(U(a[1])); break; }
    case Rt::HostGlBindVertexArray: { gl.bindVertexArray(U(a[1])); break; }
    case Rt::HostGlBindBufferBase: { gl.bindBufferBase(U(a[1]), U(a[2]), U(a[3])); break; }
    case Rt::HostGlBindBufferRange: { gl.bindBufferRange(U(a[1]), U(a[2]), U(a[3]), I(a[4]), I(a[5])); break; }
    case Rt::HostGlGetIndexedParameter: { c->param = gl.getIndexedParameter(U(a[1]), U(a[2])); break; }
    case Rt::HostGlCreateTexture: { r->i = gl.createTexture(); break; }
    case Rt::HostGlDeleteTexture: { gl.deleteTexture(U(a[1])); break; }
    case Rt::HostGlIsTexture: { r->i = gl.isTexture(U(a[1])); break; }
    case Rt::HostGlBindTexture: { gl.bindTexture(U(a[1]), U(a[2])); break; }
    case Rt::HostGlActiveTexture: { gl.activeTexture(U(a[1])); break; }
    case Rt::HostGlTexParameteri: { gl.texParameteri(U(a[1]), U(a[2]), I(a[3])); break; }
    case Rt::HostGlTexParameterf: { gl.texParameterf(U(a[1]), U(a[2]), F(a[3])); break; }
    case Rt::HostGlGetTexParameter: { c->param = gl.getTexParameter(U(a[1]), U(a[2])); break; }
    case Rt::HostGlTexImage2D: { const Bytes v9 = bytesIn(a[9], a[10]); gl.texImage2D(U(a[1]), I(a[2]), U(a[3]), I(a[4]), I(a[5]), I(a[6]), U(a[7]), U(a[8]), v9.null ? nullptr : v9.p, v9.n); break; }
    case Rt::HostGlTexSubImage2D: { const Bytes v9 = bytesIn(a[9], a[10]); if (v9.null) gl.raise(0x0501); else gl.texSubImage2D(U(a[1]), I(a[2]), I(a[3]), I(a[4]), I(a[5]), I(a[6]), U(a[7]), U(a[8]), v9.p, v9.n); break; }
    case Rt::HostGlTexImage3D: { const Bytes v10 = bytesIn(a[10], a[11]); gl.texImage3D(U(a[1]), I(a[2]), U(a[3]), I(a[4]), I(a[5]), I(a[6]), I(a[7]), U(a[8]), U(a[9]), v10.null ? nullptr : v10.p, v10.n); break; }
    case Rt::HostGlTexSubImage3D: { const Bytes v11 = bytesIn(a[11], a[12]); if (v11.null) gl.raise(0x0501); else gl.texSubImage3D(U(a[1]), I(a[2]), I(a[3]), I(a[4]), I(a[5]), I(a[6]), I(a[7]), I(a[8]), U(a[9]), U(a[10]), v11.p, v11.n); break; }
    case Rt::HostGlTexStorage2D: { gl.texStorage2D(U(a[1]), I(a[2]), U(a[3]), I(a[4]), I(a[5])); break; }
    case Rt::HostGlTexStorage3D: { gl.texStorage3D(U(a[1]), I(a[2]), U(a[3]), I(a[4]), I(a[5]), I(a[6])); break; }
    case Rt::HostGlCopyTexImage2D: { gl.copyTexImage2D(U(a[1]), I(a[2]), U(a[3]), I(a[4]), I(a[5]), I(a[6]), I(a[7]), I(a[8])); break; }
    case Rt::HostGlCopyTexSubImage2D: { gl.copyTexSubImage2D(U(a[1]), I(a[2]), I(a[3]), I(a[4]), I(a[5]), I(a[6]), I(a[7]), I(a[8])); break; }
    case Rt::HostGlCopyTexSubImage3D: { gl.copyTexSubImage3D(U(a[1]), I(a[2]), I(a[3]), I(a[4]), I(a[5]), I(a[6]), I(a[7]), I(a[8]), I(a[9])); break; }
    case Rt::HostGlCompressedTexImage2D: { const Bytes v7 = bytesIn(a[7], a[8]); if (v7.null) gl.raise(0x0501); else gl.compressedTexImage2D(U(a[1]), I(a[2]), U(a[3]), I(a[4]), I(a[5]), I(a[6]), v7.p, v7.n); break; }
    case Rt::HostGlCompressedTexSubImage2D: { const Bytes v8 = bytesIn(a[8], a[9]); if (v8.null) gl.raise(0x0501); else gl.compressedTexSubImage2D(U(a[1]), I(a[2]), I(a[3]), I(a[4]), I(a[5]), I(a[6]), U(a[7]), v8.p, v8.n); break; }
    case Rt::HostGlCompressedTexImage3D: { const Bytes v8 = bytesIn(a[8], a[9]); if (v8.null) gl.raise(0x0501); else gl.compressedTexImage3D(U(a[1]), I(a[2]), U(a[3]), I(a[4]), I(a[5]), I(a[6]), I(a[7]), v8.p, v8.n); break; }
    case Rt::HostGlCompressedTexSubImage3D: { const Bytes v10 = bytesIn(a[10], a[11]); if (v10.null) gl.raise(0x0501); else gl.compressedTexSubImage3D(U(a[1]), I(a[2]), I(a[3]), I(a[4]), I(a[5]), I(a[6]), I(a[7]), I(a[8]), U(a[9]), v10.p, v10.n); break; }
    case Rt::HostGlGenerateMipmap: { gl.generateMipmap(U(a[1])); break; }
    case Rt::HostGlCreateSampler: { r->i = gl.createSampler(); break; }
    case Rt::HostGlDeleteSampler: { gl.deleteSampler(U(a[1])); break; }
    case Rt::HostGlIsSampler: { r->i = gl.isSampler(U(a[1])); break; }
    case Rt::HostGlBindSampler: { gl.bindSampler(U(a[1]), U(a[2])); break; }
    case Rt::HostGlSamplerParameteri: { gl.samplerParameteri(U(a[1]), U(a[2]), I(a[3])); break; }
    case Rt::HostGlSamplerParameterf: { gl.samplerParameterf(U(a[1]), U(a[2]), F(a[3])); break; }
    case Rt::HostGlGetSamplerParameter: { c->param = gl.getSamplerParameter(U(a[1]), U(a[2])); break; }
    case Rt::HostGlCreateFramebuffer: { r->i = gl.createFramebuffer(); break; }
    case Rt::HostGlDeleteFramebuffer: { gl.deleteFramebuffer(U(a[1])); break; }
    case Rt::HostGlIsFramebuffer: { r->i = gl.isFramebuffer(U(a[1])); break; }
    case Rt::HostGlBindFramebuffer: { gl.bindFramebuffer(U(a[1]), U(a[2])); break; }
    case Rt::HostGlFramebufferTexture2D: { gl.framebufferTexture2D(U(a[1]), U(a[2]), U(a[3]), U(a[4]), I(a[5])); break; }
    case Rt::HostGlFramebufferTextureLayer: { gl.framebufferTextureLayer(U(a[1]), U(a[2]), U(a[3]), I(a[4]), I(a[5])); break; }
    case Rt::HostGlFramebufferRenderbuffer: { gl.framebufferRenderbuffer(U(a[1]), U(a[2]), U(a[3]), U(a[4])); break; }
    case Rt::HostGlCheckFramebufferStatus: { r->i = gl.checkFramebufferStatus(U(a[1])); break; }
    case Rt::HostGlGetFramebufferAttachmentParameter: { c->param = gl.getFramebufferAttachmentParameter(U(a[1]), U(a[2]), U(a[3])); break; }
    case Rt::HostGlCreateRenderbuffer: { r->i = gl.createRenderbuffer(); break; }
    case Rt::HostGlDeleteRenderbuffer: { gl.deleteRenderbuffer(U(a[1])); break; }
    case Rt::HostGlIsRenderbuffer: { r->i = gl.isRenderbuffer(U(a[1])); break; }
    case Rt::HostGlBindRenderbuffer: { gl.bindRenderbuffer(U(a[1]), U(a[2])); break; }
    case Rt::HostGlRenderbufferStorage: { gl.renderbufferStorage(U(a[1]), U(a[2]), I(a[3]), I(a[4])); break; }
    case Rt::HostGlRenderbufferStorageMultisample: { gl.renderbufferStorageMultisample(U(a[1]), I(a[2]), U(a[3]), I(a[4]), I(a[5])); break; }
    case Rt::HostGlGetRenderbufferParameter: { c->param = gl.getRenderbufferParameter(U(a[1]), U(a[2])); break; }
    case Rt::HostGlBlitFramebuffer: { gl.blitFramebuffer(I(a[1]), I(a[2]), I(a[3]), I(a[4]), I(a[5]), I(a[6]), I(a[7]), I(a[8]), U(a[9]), U(a[10])); break; }
    case Rt::HostGlInvalidateFramebuffer: { const auto& v2 = uints(a[2]); gl.invalidateFramebuffer(U(a[1]), v2.data(), static_cast<int>(v2.size())); break; }
    case Rt::HostGlInvalidateSubFramebuffer: { const auto& v2 = uints(a[2]); if (I(a[5]) < 0 || I(a[6]) < 0) gl.raise(0x0501); else gl.invalidateFramebuffer(U(a[1]), v2.data(), static_cast<int>(v2.size())); break; }
    case Rt::HostGlClearBufferfv: { const auto& v3 = floats(a[3]); gl.clearBufferfv(U(a[1]), I(a[2]), v3.data(), v3.size()); break; }
    case Rt::HostGlClearBufferiv: { const auto& v3 = ints(a[3]); gl.clearBufferiv(U(a[1]), I(a[2]), v3.data(), v3.size()); break; }
    case Rt::HostGlClearBufferuiv: { const auto& v3 = uints(a[3]); gl.clearBufferuiv(U(a[1]), I(a[2]), v3.data(), v3.size()); break; }
    case Rt::HostGlClearBufferfi: { gl.clearBufferfi(U(a[1]), I(a[2]), F(a[3]), I(a[4])); break; }
    case Rt::HostGlGetInternalformatParameter: { { bool ok = false; std::vector<int> v = gl.getInternalformatParameter(U(a[1]), U(a[2]), U(a[3]), ok); c->param = WebGL1::Param{}; if (ok) { c->param.kind = 'a'; c->param.ok = true; for (int x : v) c->param.v.push_back(x); } } break; }
    case Rt::HostGlReadPixels: { Bytes v7 = bytesOut(a[7], a[8]); gl.readPixels(I(a[1]), I(a[2]), I(a[3]), I(a[4]), U(a[5]), U(a[6]), v7.p, v7.n); bytesBack(v7, a[7]); break; }
    case Rt::HostGlCreateQuery: { r->i = gl.createQuery(); break; }
    case Rt::HostGlDeleteQuery: { gl.deleteQuery(U(a[1])); break; }
    case Rt::HostGlIsQuery: { r->i = gl.isQuery(U(a[1])); break; }
    case Rt::HostGlBeginQuery: { gl.beginQuery(U(a[1]), U(a[2])); break; }
    case Rt::HostGlEndQuery: { gl.endQuery(U(a[1])); break; }
    case Rt::HostGlGetQuery: { c->param = gl.getQuery(U(a[1]), U(a[2])); break; }
    case Rt::HostGlGetQueryParameter: { c->param = gl.getQueryParameter(U(a[1]), U(a[2])); break; }
    case Rt::HostGlFenceSync: { r->i = gl.fenceSync(U(a[1]), U(a[2])); break; }
    case Rt::HostGlIsSync: { r->i = gl.isSync(U(a[1])); break; }
    case Rt::HostGlDeleteSync: { gl.deleteSync(U(a[1])); break; }
    case Rt::HostGlClientWaitSync: { r->i = gl.clientWaitSync(U(a[1]), U(a[2]), a[3].d); break; }
    case Rt::HostGlWaitSync: { gl.waitSync(U(a[1]), U(a[2]), static_cast<std::int64_t>(a[3].d)); break; }
    case Rt::HostGlGetSyncParameter: { c->param = gl.getSyncParameter(U(a[1]), U(a[2])); break; }
    case Rt::HostGlCreateTransformFeedback: { r->i = gl.createTransformFeedback(); break; }
    case Rt::HostGlDeleteTransformFeedback: { gl.deleteTransformFeedback(U(a[1])); break; }
    case Rt::HostGlIsTransformFeedback: { r->i = gl.isTransformFeedback(U(a[1])); break; }
    case Rt::HostGlBindTransformFeedback: { gl.bindTransformFeedback(U(a[1]), U(a[2])); break; }
    case Rt::HostGlBeginTransformFeedback: { gl.beginTransformFeedback(U(a[1])); break; }
    case Rt::HostGlEndTransformFeedback: { gl.endTransformFeedback(); break; }
    case Rt::HostGlPauseTransformFeedback: { gl.pauseTransformFeedback(); break; }
    case Rt::HostGlResumeTransformFeedback: { gl.resumeTransformFeedback(); break; }
    case Rt::HostGlTransformFeedbackVaryings: { const auto v2 = lines(S(a[2])); gl.transformFeedbackVaryings(U(a[1]), v2, U(a[3])); break; }
    case Rt::HostGlGetTransformFeedbackVarying: { c->active = gl.getTransformFeedbackVarying(U(a[1]), U(a[2])); break; }
    case Rt::HostGlEnableiOES: { gl.enablei(U(a[1]), U(a[2])); break; }
    case Rt::HostGlDisableiOES: { gl.disablei(U(a[1]), U(a[2])); break; }
    case Rt::HostGlIsEnablediOES: { r->i = gl.isEnabledi(U(a[1]), U(a[2])); break; }
    case Rt::HostGlBlendEquationiOES: { gl.blendEquationi(U(a[1]), U(a[2])); break; }
    case Rt::HostGlBlendEquationSeparateiOES: { gl.blendEquationSeparatei(U(a[1]), U(a[2]), U(a[3])); break; }
    case Rt::HostGlBlendFunciOES: { gl.blendFunci(U(a[1]), U(a[2]), U(a[3])); break; }
    case Rt::HostGlBlendFuncSeparateiOES: { gl.blendFuncSeparatei(U(a[1]), U(a[2]), U(a[3]), U(a[4]), U(a[5])); break; }
    case Rt::HostGlColorMaskiOES: { gl.colorMaski(U(a[1]), (a[2].i != 0), (a[3].i != 0), (a[4].i != 0), (a[5].i != 0)); break; }
    case Rt::HostGlLoseContext: { c->lose(); break; }
    case Rt::HostGlRestoreContext: { c->restore(); break; }
    case Rt::HostGlPresent: { present(*c, I(a[1])); break; }
    case Rt::HostGlDestroy: { gCtx[a[0].i - 1].reset(); gCur = nullptr; break; }
    case Rt::HostGlParamKind: { r->i = c->param.ok ? c->param.kind : 'n'; break; }
    case Rt::HostGlParamCount: { r->i = static_cast<std::int64_t>(c->param.v.size()); break; }
    case Rt::HostGlParamNumber: { r->d = I(a[1]) >= 0 && static_cast<std::size_t>(I(a[1])) < c->param.v.size() ? c->param.v[I(a[1])] : 0; break; }
    case Rt::HostGlParamText: { retStr(r, c->param.s); break; }
    case Rt::HostGlParamObject: { r->i = c->param.object; break; }
    case Rt::HostGlParamObjectKind: { r->i = c->param.objKind; break; }
    case Rt::HostGlActiveInfo: { retStr(r, c->active.ok ? std::to_string(c->active.size) + ' ' + std::to_string(c->active.type) + ' ' + c->active.name : std::string()); break; }
// end of the generated rows
